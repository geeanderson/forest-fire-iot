/*
   Forest Fire IoT - Gateway (LoRa receiver -> WiFi -> AWS IoT Core)

   Board: LilyGO T-Beam Supreme, ESP32-S3 + SX1262, 915.2 MHz (Brazil).
   Wi-Fi and every LoRa radio setting come from the shared
   firmware/site_config.h, the same file the sensor nodes use; the AWS IoT
   endpoint and certificates come from firmware/gateway_aws.h, generated by
   Terraform.

   For every LoRa packet from the sensor nodes:
     1. RAW forward (optional): only if LOGGER_SERVER_URL is defined in
        site_config.h, the payload goes via WiFi HTTP POST to a local logger,
        for field diagnostics.
     2. AWS forward: the JSON is parsed and republished, with the gateway's
        timestamp and RSSI, via MQTT+TLS to AWS IoT Core on
        forest-fire/<device_id>/sensors. Packets without a device_id are
        dropped (never attributed to a default node).

   Node payload: {"device_id","timestamp","temperature","humidity",
                  "air_quality","battery_voltage","rssi"}
   air_quality is a placeholder (MQ-135 not in the BOM) and isn't forwarded.

   Based on the LilyGO RadioLib Receive_Interrupt example.
*/

#include <RadioLib.h>
#include "LoRaBoards.h"
#include <WiFi.h>
#include <HTTPClient.h>
#include <WiFiClientSecure.h>
#include <PubSubClient.h>
#include <ArduinoJson.h>
#include <time.h>
#if __has_include("site_config.h")
#include "site_config.h"
#else
#error "firmware/site_config.h not found: cp firmware/site_config.h.example firmware/site_config.h and fill it in"
#endif

// AWS IoT endpoint, client ID and certificates, generated by Terraform.
#if __has_include("gateway_aws.h")
#include "gateway_aws.h"
#else
#error "firmware/gateway_aws.h not found: cd cloud/iac/terraform && tofu output -raw gateway_aws_config > ../../../firmware/gateway_aws.h"
#endif

#define NTP_SERVER "pool.ntp.org"

static WiFiClientSecure awsClient;
static PubSubClient     awsMqtt(awsClient);
static uint32_t         awsPublishedCount = 0;
static uint32_t         awsFailedCount    = 0;

#if     defined(USING_SX1276)
SX1276 radio = new Module(RADIO_CS_PIN, RADIO_DIO0_PIN, RADIO_RST_PIN, RADIO_DIO1_PIN);

#elif   defined(USING_SX1262)
SX1262 radio = new Module(RADIO_CS_PIN, RADIO_DIO1_PIN, RADIO_RST_PIN, RADIO_BUSY_PIN);

#else
#error "This sketch was set up for SX1276/SX1262 boards (T-Beam Supreme). Add your radio block if needed."
#endif

static volatile bool receivedFlag = false;
static String rssi = "0dBm";
static String snr = "0dB";
static String payload = "0";
#ifdef LOGGER_SERVER_URL
static uint32_t forwardedCount = 0;
static uint32_t failedForwardCount = 0;
#endif

void setFlag(void)
{
    receivedFlag = true;
}

void connectWiFi()
{
    Serial.printf("Connecting to WiFi \"%s\" ", WIFI_SSID);
    WiFi.mode(WIFI_STA);
    WiFi.begin(WIFI_SSID, WIFI_PASSWORD);
    uint32_t start = millis();
    while (WiFi.status() != WL_CONNECTED && millis() - start < 15000) {
        delay(300);
        Serial.print(".");
    }
    if (WiFi.status() == WL_CONNECTED) {
        Serial.printf(" connected! IP: %s\n", WiFi.localIP().toString().c_str());
    } else {
        Serial.println(" failed (will keep retrying in background).");
    }
}

// Current UTC time as ISO-8601, from the gateway's NTP-synced clock. Used
// instead of the sensor node's RTC (unsynced/wrong on the bench unit today).
String isoTimestamp()
{
    struct tm ti;
    if (!getLocalTime(&ti)) return "1970-01-01T00:00:00Z";
    char buf[32];
    strftime(buf, sizeof(buf), "%Y-%m-%dT%H:%M:%SZ", &ti);
    return String(buf);
}

void ensureAWSMQTT()
{
    if (awsMqtt.connected()) return;
    Serial.print("[aws] connecting to AWS IoT Core");
    for (int i = 0; i < 5 && !awsMqtt.connected(); i++) {
        if (awsMqtt.connect(AWS_IOT_CLIENT_ID)) {
            Serial.println(" OK");
            return;
        }
        delay(1000);
        Serial.print(".");
    }
    Serial.printf(" FAILED state=%d (will retry) — check certs/endpoint\n", awsMqtt.state());
}

// Parses the sensor node's raw JSON payload (Heltec V4 nodes, see
// firmware/node) and republishes the fields the ML pipeline
// needs (device_id/timestamp/temperature/humidity, plus battery/location as
// optional extras — see cloud/lambda/process_sensor_data) as JSON to
// forest-fire/<device_id>/sensors on AWS IoT Core.
bool publishToAWS(const String &rawPayload, float rssiVal)
{
    StaticJsonDocument<384> in;
    DeserializationError err = deserializeJson(in, rawPayload);
    if (err) {
        Serial.printf("[aws] payload isn't valid JSON (%s), skipping AWS publish\n", err.c_str());
        return false;
    }

    if (!in.containsKey("temperature") || !in.containsKey("humidity")) {
        Serial.println("[aws] sensor reading unavailable, skipping AWS publish");
        return false;
    }

    if (WiFi.status() != WL_CONNECTED) {
        Serial.println("[aws] WiFi down, skipping AWS publish");
        return false;
    }
    ensureAWSMQTT();
    if (!awsMqtt.connected()) return false;

    const char *deviceId = in["device_id"] | "";
    if (deviceId[0] == '\0') {
        Serial.println("[aws] payload has no device_id, skipping AWS publish");
        return false;
    }

    StaticJsonDocument<384> doc;
    doc["device_id"]   = deviceId;
    doc["timestamp"]   = isoTimestamp();
    doc["temperature"] = in["temperature"].as<float>();
    doc["humidity"]    = in["humidity"].as<float>();
    doc["rssi"]        = rssiVal;

    if (in.containsKey("battery_voltage")) {
        doc["battery_voltage"] = in["battery_voltage"].as<float>();
    }

    if (in.containsKey("location")) {
        JsonObject loc = doc.createNestedObject("location");
        loc["lat"] = in["location"]["lat"].as<float>();
        loc["lon"] = in["location"]["lon"].as<float>();
    }

    char buf[384];
    size_t n = serializeJson(doc, buf, sizeof(buf));

    String topic = String("forest-fire/") + deviceId + "/sensors";
    bool ok = awsMqtt.publish(topic.c_str(), (const uint8_t *)buf, n, false);
    if (ok) {
        awsPublishedCount++;
        Serial.printf("[aws] -> %s (#%lu)\n", topic.c_str(), (unsigned long)awsPublishedCount);
    } else {
        awsFailedCount++;
        Serial.printf("[aws] publish FAILED (#%lu failed)\n", (unsigned long)awsFailedCount);
    }
    return ok;
}

// Forward one raw payload string to the local logger server. Non-blocking
// failures (WiFi down, server unreachable) are logged but never crash the
// receive loop - a dropped forward just means that one packet isn't
// recorded on the computer; the sensor node keeps transmitting regardless.
#ifdef LOGGER_SERVER_URL
bool forwardToLogger(const String &rawPayload, float rssiVal, float snrVal)
{
    if (WiFi.status() != WL_CONNECTED) {
        Serial.println("[WiFi] not connected, skipping forward, reconnecting...");
        WiFi.reconnect();
        return false;
    }

    HTTPClient http;
    http.begin(LOGGER_SERVER_URL);
    http.addHeader("Content-Type", "application/json");
    http.setTimeout(3000);

    // rawPayload is itself a JSON string (sensor node payload) since the
    // Heltec V4 nodes replaced the CSV-based M10S sensor - it must be
    // embedded as a properly escaped JSON string value here, not
    // concatenated raw (that used to corrupt this wrapper's own JSON,
    // since the sensor payload's unescaped quotes broke it).
    StaticJsonDocument<384> doc;
    doc["raw_payload"] = rawPayload;
    doc["rssi_dbm"] = rssiVal;
    doc["snr_db"] = snrVal;
    doc["gateway_millis"] = millis();
    String body;
    serializeJson(doc, body);

    int code = http.POST(body);
    http.end();

    if (code > 0) {
        return true;
    }
    Serial.printf("[HTTP] POST failed, code=%d\n", code);
    return false;
}
#endif

void setup()
{
    setupBoards();
    delay(1500);

#ifdef  RADIO_TCXO_ENABLE
    pinMode(RADIO_TCXO_ENABLE, OUTPUT);
    digitalWrite(RADIO_TCXO_ENABLE, HIGH);
#endif

    int state = radio.begin();
    printResult(state == RADIOLIB_ERR_NONE);

    Serial.printf("[%s]:", RADIO_TYPE_STR);
    Serial.print(F("Radio Initializing ... "));
    if (state == RADIOLIB_ERR_NONE) {
        Serial.println(F("success!"));
    } else {
        Serial.print(F("failed, code "));
        Serial.println(state);
        while (true);
    }

    radio.setPacketReceivedAction(setFlag);

    if (radio.setFrequency(LORA_FREQUENCY_MHZ) == RADIOLIB_ERR_INVALID_FREQUENCY) {
        Serial.println(F("Selected frequency is invalid for this module!"));
        while (true);
    }
    if (radio.setBandwidth(LORA_BANDWIDTH_KHZ) == RADIOLIB_ERR_INVALID_BANDWIDTH) {
        Serial.println(F("Selected bandwidth is invalid for this module!"));
        while (true);
    }
    if (radio.setSpreadingFactor(LORA_SPREADING_FACTOR) == RADIOLIB_ERR_INVALID_SPREADING_FACTOR) {
        Serial.println(F("Selected spreading factor is invalid for this module!"));
        while (true);
    }
    if (radio.setCodingRate(LORA_CODING_RATE) == RADIOLIB_ERR_INVALID_CODING_RATE) {
        Serial.println(F("Selected coding rate is invalid for this module!"));
        while (true);
    }
    if (radio.setSyncWord(LORA_SYNC_WORD) != RADIOLIB_ERR_NONE) {
        Serial.println(F("Unable to set sync word!"));
        while (true);
    }
    if (radio.setOutputPower(LORA_TX_POWER_DBM) == RADIOLIB_ERR_INVALID_OUTPUT_POWER) {
        Serial.println(F("Selected output power is invalid for this module!"));
        while (true);
    }
#if !defined(USING_SX1280) && !defined(USING_LR1121) && !defined(USING_SX1280PA)
    if (radio.setCurrentLimit(140) == RADIOLIB_ERR_INVALID_CURRENT_LIMIT) {
        Serial.println(F("Selected current limit is invalid for this module!"));
        while (true);
    }
#endif
    if (radio.setPreambleLength(LORA_PREAMBLE_LENGTH) == RADIOLIB_ERR_INVALID_PREAMBLE_LENGTH) {
        Serial.println(F("Selected preamble length is invalid for this module!"));
        while (true);
    }
    // CRC on (site_config.h): at long range/weak SNR a disabled CRC let a
    // corrupted payload (bad timestamp) through silently.
    if (radio.setCRC(LORA_CRC_ENABLED) == RADIOLIB_ERR_INVALID_CRC_CONFIGURATION) {
        Serial.println(F("Selected CRC is invalid for this module!"));
        while (true);
    }

#ifdef USING_DIO2_AS_RF_SWITCH
#ifdef USING_SX1262
    if (radio.setDio2AsRfSwitch() != RADIOLIB_ERR_NONE) {
        Serial.println(F("Failed to set DIO2 as RF switch!"));
        while (true);
    }
#endif
#endif

    connectWiFi();
    configTime(0, 0, NTP_SERVER);
    Serial.print("[ntp] syncing time");
    {
        struct tm ti;
        uint32_t ntpStart = millis();
        while (!getLocalTime(&ti, 1000) && millis() - ntpStart < 10000) {
            Serial.print(".");
        }
        Serial.println(getLocalTime(&ti, 10) ? " OK" : " TIMEOUT (system clock may be wrong)");
    }

    awsClient.setCACert(AWS_CERT_CA);
    awsClient.setCertificate(AWS_CERT_CRT);
    awsClient.setPrivateKey(AWS_CERT_PRIVATE);
    awsMqtt.setServer(AWS_IOT_ENDPOINT, AWS_IOT_PORT);
    awsMqtt.setBufferSize(512);
    ensureAWSMQTT();

    Serial.print(F("Radio Starting to listen ... "));
    state = radio.startReceive();
    if (state == RADIOLIB_ERR_NONE) {
        Serial.println(F("success!"));
    } else {
        Serial.print(F("failed, code "));
        Serial.println(state);
    }

    drawMain();
}

void loop()
{
    // Keep WiFi alive without blocking LoRa reception.
    static uint32_t lastWiFiCheck = 0;
    if (WiFi.status() != WL_CONNECTED && millis() - lastWiFiCheck > 10000) {
        lastWiFiCheck = millis();
        Serial.println("[WiFi] reconnecting...");
        WiFi.reconnect();
    }

    // Periodic WiFi RSSI print + OLED refresh, independent of LoRa RX -
    // added 2026-09-19 to check signal quality/stability while relocating
    // the gateway to a new environment (walking-test friendly: no need to
    // wait for a sensor node to transmit to see live signal strength).
    static uint32_t lastRssiLog = 0;
    if (millis() - lastRssiLog > 3000) {
        lastRssiLog = millis();
        if (WiFi.status() == WL_CONNECTED) {
            Serial.printf("[WiFi] RSSI: %ddBm\n", WiFi.RSSI());
        } else {
            Serial.println("[WiFi] not connected");
        }
        drawMain();
    }

    if (WiFi.status() == WL_CONNECTED) {
        if (!awsMqtt.connected()) {
            ensureAWSMQTT();
        }
        awsMqtt.loop();
    }

    if (receivedFlag) {
        receivedFlag = false;

        int state = radio.readData(payload);
        flashLed();

        if (state == RADIOLIB_ERR_NONE) {
            rssi = String(radio.getRSSI()) + "dBm";
            snr = String(radio.getSNR()) + "dB";

            drawMain();

            Serial.println(F("Radio Received packet!"));
            Serial.print(F("Radio Data:\t\t"));
            Serial.println(payload);
            Serial.print(F("Radio RSSI:\t\t"));
            Serial.println(rssi);
            Serial.print(F("Radio SNR:\t\t"));
            Serial.println(snr);

#ifdef LOGGER_SERVER_URL
            bool ok = forwardToLogger(payload, radio.getRSSI(), radio.getSNR());
            if (ok) {
                forwardedCount++;
                Serial.printf("[Gateway] forwarded to logger (total=%lu)\n", (unsigned long)forwardedCount);
            } else {
                failedForwardCount++;
                Serial.printf("[Gateway] forward FAILED (total failed=%lu)\n", (unsigned long)failedForwardCount);
            }
#endif

            publishToAWS(payload, radio.getRSSI());

        } else if (state == RADIOLIB_ERR_CRC_MISMATCH) {
            Serial.println(F("CRC error!"));
        } else {
            Serial.print(F("failed, code "));
            Serial.println(state);
        }

        radio.startReceive();
    }
}

void drawMain()
{
    if (disp) {
        disp->clearBuffer();
        disp->drawRFrame(0, 0, 128, 64, 5);
        disp->setFont(u8g2_font_pxplusibmvga8_mr);
        disp->setCursor(4, 15);
        if (WiFi.status() == WL_CONNECTED) {
            disp->printf("WiFi:OK %ddBm", WiFi.RSSI());
        } else {
            disp->printf("WiFi:--");
        }
        disp->setCursor(4, 30);
        disp->printf("RX SNR:%s", snr.c_str());
        disp->setCursor(4, 45);
#ifdef LOGGER_SERVER_URL
        disp->printf("Fwd OK:%lu", (unsigned long)forwardedCount);
        disp->setCursor(4, 60);
        disp->printf("Fwd ERR:%lu", (unsigned long)failedForwardCount);
#else
        disp->printf("AWS OK:%lu", (unsigned long)awsPublishedCount);
        disp->setCursor(4, 60);
        disp->printf("AWS ERR:%lu", (unsigned long)awsFailedCount);
#endif
        disp->sendBuffer();
    }
}
